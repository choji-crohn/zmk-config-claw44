## boards/shields/claw44/Kconfig.defconfig
```kconfig
# Copyright (c) 2021 The ZMK Contributors
# SPDX-License-Identifier: MIT

if SHIELD_CLAW44_L

config ZMK_KEYBOARD_NAME
    default "Claw44-ZMK"

config ZMK_SPLIT_ROLE_CENTRAL
    default y

endif

if SHIELD_CLAW44_L || SHIELD_CLAW44_R

config ZMK_SPLIT
    default y

if ZMK_DISPLAY

config I2C
    default y

config SSD1306
    default y

endif # ZMK_DISPLAY

if LVGL

config LV_Z_VDB_SIZE
    default 64

config LV_DPI_DEF
    default 148

config LV_Z_BITS_PER_PIXEL
    default 1

choice LV_COLOR_DEPTH
    default LV_COLOR_DEPTH_1
endchoice

endif # LVGL

endif
```

## boards/shields/claw44/Kconfig.shield
```kconfig
# Copyright (c) 2021 The ZMK Contributors
# SPDX-License-Identifier: MIT

config SHIELD_CLAW44_L
    def_bool $(shields_list_contains,claw44_L)

config SHIELD_CLAW44_R
    def_bool $(shields_list_contains,claw44_R)
```
